## sw/fw_periph_dma/zephyr/Kconfig
```kconfig
menuconfig FW_PERIPH_DMA
		bool "Featherweight IP Peripheral DMA Engine"
		default y
		help
			This module provides a driver for the fwperiph-dma IP
			
```

## verilog/dv/fwperiph_dma_wb_uvm/zephyr/boards/posix/fwperiph_dma/Kconfig.board
```kconfig
# SPDX-License-Identifier: Apache-2.0

config BOARD_FWPERIPH_DMA_32BIT
	bool "Native POSIX for 32-bit host"
	depends on SOC_COSIM
	select BOARD_FWPERIPH_DMA
	help
	  Will produce a console Linux process which can be executed natively
	  as a 32-bit executable.
	  It provides some minimal needed models:
	  An interrupt controller, timer (system tick), and redirects kernel prints to
	  stdout.

config BOARD_FWPERIPH_DMA_64BIT
	bool "Native POSIX for 64-bit host"
	depends on SOC_COSIM
	select BOARD_FWPERIPH_DMA
	select 64BIT
	help
	  Will produce a console Linux process which can be executed natively
	  as a 64-bit executable.
	  It provides some minimal needed models:
	  An interrupt controller, timer (system tick), and redirects kernel prints to
	  stdout.
```

## verilog/dv/fwperiph_dma_wb_uvm/zephyr/boards/posix/fwperiph_dma/fwperiph_dma_defconfig
```kconfig
# SPDX-License-Identifier: Apache-2.0


CONFIG_SOC_COSIM=y
CONFIG_BOARD_FWPERIPH_DMA_32BIT=y
CONFIG_CONSOLE=y
CONFIG_SYS_CLOCK_HW_CYCLES_PER_SEC=1000000
```
